## Config.in
```kconfig
# make the variant name available as a Config.in variable
#
# you can use BR2SM_PROJECT_NAME to have some options only appear for some variants
#
config BR2SM_PROJECT_NAME
	string
	option env="PROJECT_NAME"
source "$BR2_EXTERNAL/package/swupdate-custom/Config.in"
```

## defconfig
```kconfig
BR2_arm=y
BR2_arm1176jzf_s=y
BR2_DL_DIR="$(BR2_EXTERNAL)/dl"
BR2_PACKAGE_OVERRIDE_FILE="$(BR2_EXTERNAL)/local.mk"
BR2_GLOBAL_PATCH_DIR="$(BR2_EXTERNAL)/patch"
BR2_TOOLCHAIN_EXTERNAL=y
BR2_TOOLCHAIN_EXTERNAL_CUSTOM=y
BR2_TOOLCHAIN_EXTERNAL_PATH="${BR2_EXTERNAL}/toolchain/output/host/usr"
BR2_TOOLCHAIN_EXTERNAL_GCC_4_9=y
BR2_TOOLCHAIN_EXTERNAL_HEADERS_4_6=y
BR2_TOOLCHAIN_EXTERNAL_CUSTOM_GLIBC=y
BR2_TOOLCHAIN_EXTERNAL_CXX=y
BR2_TARGET_GENERIC_ROOT_PASSWD="hello"
BR2_SYSTEM_DHCP="eth0"
BR2_ROOTFS_OVERLAY="$(BR2_EXTERNAL)/overlay"
BR2_ROOTFS_POST_BUILD_SCRIPT="board/raspberrypi/post-build.sh"
BR2_ROOTFS_POST_IMAGE_SCRIPT="board/raspberrypi/post-image.sh "
BR2_LINUX_KERNEL=y
BR2_LINUX_KERNEL_CUSTOM_GIT=y
BR2_LINUX_KERNEL_CUSTOM_REPO_URL="https://github.com/raspberrypi/linux.git"
BR2_LINUX_KERNEL_CUSTOM_REPO_VERSION="26f3b72a9c049be10e6af196252283e1f6ab9d1f"
BR2_LINUX_KERNEL_DEFCONFIG="bcmrpi"
BR2_LINUX_KERNEL_DTS_SUPPORT=y
BR2_LINUX_KERNEL_INTREE_DTS_NAME="bcm2708-rpi-b bcm2708-rpi-b-plus bcm2708-rpi-cm"
BR2_PACKAGE_BUSYBOX_SHOW_OTHERS=y
BR2_PACKAGE_RPI_FIRMWARE=y
# BR2_PACKAGE_RPI_FIRMWARE_INSTALL_DTB_OVERLAYS is not set
BR2_TARGET_ROOTFS_EXT2=y
BR2_TARGET_ROOTFS_EXT2_4=y
# BR2_TARGET_ROOTFS_TAR is not set
BR2_TARGET_UBOOT=y
BR2_TARGET_UBOOT_BOARDNAME="rpi"
BR2_PACKAGE_HOST_DOSFSTOOLS=y
BR2_PACKAGE_HOST_GENIMAGE=y
BR2_PACKAGE_HOST_MTOOLS=y
BR2_PACKAGE_SWUPDATE_CUSTOM=y
# BR2_PACKAGE_SWUPDATE_CUSTOM_INSTALL_WEBSITE is not set
```

## package/swupdate-custom/Config.in
```kconfig
config BR2_PACKAGE_SWUPDATE_CUSTOM
	bool "swupdate-custom"
	depends on BR2_TOOLCHAIN_HAS_THREADS
	depends on BR2_USE_MMU # fork()
	# swupdate-custom requires a parser and uses libconfig as default
	select BR2_PACKAGE_LIBCONFIG if !BR2_PACKAGE_JSON_C && !BR2_PACKAGE_LUA_5_2
	help
	  swupdate-custom provides a reliable way to update the software on an
	  embedded system.

	  swupdate-custom is highly configurable to fit the targets requirements and
	  to minimize the footprint. The provided default configuration file
	  BR2_PACKAGE_SWUPDATE_CUSTOM_CONFIG will enable swupdate-custom with an embedded
	  webserver, a parser and a handler for raw NAND or NOR flash.

	  The default configuration file builds a reasonable firmware update
	  system with minimal external dependencies in my mind. If you like to
	  use your own modified configuration, you have to select the
	  necessary packages manually:

	  * Select BR2_PACKAGE_LUA if you want to have Lua support.
	  * Select BR2_LIBCURL if you want to use the download feature.
	  * Select BR2_PACKAGE_OPENSSL is you want to add encryptions support
	    to the webserver.
	  * Select BR2_PACKAGE_MTD if you want to use swupdate-custom with UBI
	    partitions.
	  * Select BR2_PACKAGE_ZLIB if you want to deal with gzip compressed
	    archives.
	  * Select BR2_PACKAGE_UBOOT_TOOLS and BR2_PACKAGE_ZLIB to add support
	    for setting the U-Boot environment.

	  https://sbabic.github.io/swupdate

if BR2_PACKAGE_SWUPDATE_CUSTOM

config BR2_PACKAGE_SWUPDATE_CUSTOM_CONFIG
	string "swupdate-custom configuration file"
	default "${BR2_EXTERNAL}/package/swupdate-custom/swupdate-custom.config"
	help
	  Path to the swupdate-custom configuration file.

	  I you wish to use your own modified swupdate-custom configuration file
	  specify the config file location with this option.

config BR2_PACKAGE_SWUPDATE_CUSTOM_INSTALL_WEBSITE
	bool "install default website"
	default y
	help
	  Install the provided website to /var/www/swupdate-custom.

	  This is necessary if you want to run swupdate-custom with the embedded
	  webserver and do not provide an own website to be installed to
	  /var/www/swupdate-custom.
endif

comment "swupdate-custom needs a toolchain w/ threads"
	depends on BR2_USE_MMU
	depends on !BR2_TOOLCHAIN_HAS_THREADS
```

## toolchain/defconfig
```kconfig
BR2_arm=y
BR2_arm1176jzf_s=y
BR2_DL_DIR="$(BR2_EXTERNAL)/dl"
BR2_PACKAGE_OVERRIDE_FILE="$(BR2_EXTERNAL)/local.mk"
BR2_GLOBAL_PATCH_DIR="$(BR2_EXTERNAL)/patch"
BR2_TOOLCHAIN_BUILDROOT_GLIBC=y
BR2_TOOLCHAIN_BUILDROOT_CXX=y
BR2_INIT_NONE=y
BR2_ROOTFS_OVERLAY="$(BR2_EXTERNAL)/overlay"
BR2_ROOTFS_POST_BUILD_SCRIPT="board/raspberrypi/post-build.sh"
BR2_ROOTFS_POST_IMAGE_SCRIPT="board/raspberrypi/post-image.sh"
# BR2_PACKAGE_BUSYBOX is not set
BR2_PACKAGE_RPI_FIRMWARE=y
# BR2_PACKAGE_RPI_FIRMWARE_INSTALL_DTB_OVERLAYS is not set
BR2_TARGET_ROOTFS_EXT2=y
BR2_TARGET_ROOTFS_EXT2_4=y
# BR2_TARGET_ROOTFS_TAR is not set
BR2_PACKAGE_HOST_DOSFSTOOLS=y
BR2_PACKAGE_HOST_GENIMAGE=y
BR2_PACKAGE_HOST_MTOOLS=y
```
